#include <SPI.h>
#include <FastGPIO.h>

// ============================
// User configurations

// Default font size is too small to read.
// Set scale to 2 for normal use. Set to 3 for demonstration.
constexpr int TEXT_SCALE = 2;

// This is the margin between actual heating points and printer case.
// Increase this value if you use your own case.
constexpr int FEED_MARGIN = 40;

// Half-step cycle of step motor, in microseconds.
// May need to change this for different printheads.
constexpr unsigned int MOTOR_HALF_STEP_TIME = 500;


// ============================
// Hardware configurations

// Pins
#define MOT1_PIN        FastGPIO::Pin<10>
#define MOT2_PIN        FastGPIO::Pin<9>
#define MOT3_PIN        FastGPIO::Pin<6>
#define MOT4_PIN        FastGPIO::Pin<5>
#define PRNPOWER_PIN    FastGPIO::Pin<4>
#define LATCH_PIN       FastGPIO::Pin<7>
#define STROBE_PIN      FastGPIO::Pin<8>
#define PAPERSNS_PIN    FastGPIO::Pin<12>
#define PRNTEMP_PIN     A0

// IO operations
#define PRNPOWER_L  PRNPOWER_PIN::setOutputValueLow()
#define PRNPOWER_H  PRNPOWER_PIN::setOutputValueHigh()
#define LATCH_L     LATCH_PIN::setOutputValueLow()
#define LATCH_H     LATCH_PIN::setOutputValueHigh()
#define STROBE_L    STROBE_PIN::setOutputValueLow()
#define STROBE_H    STROBE_PIN::setOutputValueHigh()


#define ARRAY_SIZE(x)  (sizeof(x) / sizeof((x)[0]))


// ============================
// Step motor driver

// Step motor phase signals, half-step method
static constexpr uint8_t MOTOR_PHASES[][4] = {
    {1, 0, 0, 0},
    {1, 0, 0, 1},
    {0, 0, 0, 1},
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    {1, 0, 1, 0},
};

class StepMotor
{
public:
    StepMotor() {
        MOT1_PIN::setOutputLow();
        MOT2_PIN::setOutputLow();
        MOT3_PIN::setOutputLow();
        MOT4_PIN::setOutputLow();
    }

public:
    // Idle state consumes no power
    void idle() {
        const uint8_t IDLE_PHASES[] = {0, 0, 0, 0};
        setPhases(IDLE_PHASES);
    }

    // One half-step forward or backward
    void step(bool forward = true) {
        const int totalSteps = ARRAY_SIZE(MOTOR_PHASES);
        currStep = (currStep + totalSteps + (forward ? 1 : -1)) % totalSteps;
        setPhases(MOTOR_PHASES[currStep]);
    }

private:
    void setPhases(const uint8_t values[4]) {
        MOT1_PIN::setOutputValue(values[0]);
        MOT2_PIN::setOutputValue(values[1]);
        MOT3_PIN::setOutputValue(values[2]);
        MOT4_PIN::setOutputValue(values[3]);
    }

private:
    int currStep = -1;
};


// ============================
// Printing

// First character value in table
constexpr char CHAR_BEGIN = 32;
// This is a fixed-width font
constexpr int CHAR_WIDTH  = 8;
constexpr int CHAR_HEIGHT = 16;

// 2 inch thermal printhead, 384 points
constexpr int ROW_WIDTH = 384;

// Font raster images. Each character is 16 bytes
static constexpr uint8_t CHAR_RASTERS[][CHAR_HEIGHT] = {
    {0x00,0x00,0x00,0x00,0x00,0x00,0x00,0x00,0x00,0x00,0x00,0x00,0x00,0x00,0x00,0x00},/*" ",0*/
    {0x00,0x00,0x00,0x18,0x3C,0x3C,0x3C,0x18,0x18,0x00,0x18,0x18,0x00,0x00,0x00,0x00},/*"!",1*/
    {0x00,0x00,0x00,0x66,0x66,0x66,0x00,0x00,0x00,0x00,0x00,0x00,0x00,0x00,0x00,0x00},/*""",2*/
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    {0x00,0x00,0x00,0x71,0xDB,0x8E,0x00,0x00,0x00,0x00,0x00,0x00,0x00,0x00,0x00,0x00},/*"~",94*/
};


// Text layout format
struct TextFormat
{
    uint8_t scale = 1;
    enum : uint8_t {
        AlignLeft,
        AlignMiddle,
        AlignRight,
    } align = AlignLeft;
};


// Thermal printhead driver
class ThermalPrinter
{
public:
    ThermalPrinter() {
        // use SPI to send print data
        SPI.begin();

        PRNPOWER_PIN::setOutputLow();
        LATCH_PIN::setOutputHigh();
        STROBE_PIN::setOutputLow();
        PAPERSNS_PIN::setInput();

        reset();
    }

public:
    // Heating power on/off
    void powerOn() {
        PRNPOWER_H;
    }

    void powerOff() {
        PRNPOWER_L;
    }

    // Idle the step motor to reduce power consumption
    void idle() {
        motor.idle();
    }

    // Whether paper is loaded
    bool isPaperReady() {
        return !PAPERSNS_PIN::isInputHigh();
    }

    // Stop heating and idle the step motor
    void reset() {
        // according to datasheet, it's good to clear printing data after powered on
        STROBE_L;

        LATCH_L;
        for (int i = 0; i < ROW_WIDTH / 8; i++) {
            SPI.transfer(0);
        }
        LATCH_H;

        motor.idle();
    }

    // Feed paper for `count` lines, may be positive or negative
    void feedLine(int count) {
        if (!isPaperReady() || count == 0) {
            return;
        }

        const int stepsPerLine = ARRAY_SIZE(MOTOR_PHASES) / 2;
        for (int i = 0; i < stepsPerLine * abs(count); i++) {
            motor.step(count > 0);
            delayMicroseconds(MOTOR_HALF_STEP_TIME);
        }
    }

    // Print one line of pixels, 1bpp data format (1 is black).
    // After calling this, `data` will be cleared to 0's
    void printLine1b(uint8_t* data) {
        if (!isPaperReady()) {
            return;
        }
        
        beginPrintLine(data);
        feedLine(1);
        endPrintLine();
    }

    // Print a line of text with specified format.
    // Long text will be clipped
    void printText(const char* text, TextFormat format = {}) {
        if (!isPaperReady() || !text) {
            return;
        }

        // cut long text
        int lineChars = ROW_WIDTH / CHAR_WIDTH / format.scale;
        lineChars = min(lineChars, (int)strlen(text));
        if (lineChars < 1) {
            return;
        }

        // convert to raster image indexes.
        // unknown characters are replaced with '?'
        uint16_t rasterIndexes[lineChars];
        for (int i = 0; i < lineChars; i++) {
            int c = text[i];
            c -= CHAR_BEGIN;
            if (c < 0 || c >= (int)ARRAY_SIZE(CHAR_RASTERS)) {
                c = '?' - CHAR_BEGIN;
            }
            rasterIndexes[i] = (uint16_t)c;
        }

        // alignment
        int startX;
        int paddingX = ROW_WIDTH - lineChars * CHAR_WIDTH * format.scale;
        switch (format.align) {
            case TextFormat::AlignMiddle:
                startX = paddingX / 2;
                break;
            case TextFormat::AlignRight:
                startX = paddingX;
                break;
            default:
                startX = 0;
                break;
        }

        // rasterize row by row
        uint8_t rowBitData[ROW_WIDTH / 8];
        for (int y = 0; y < CHAR_HEIGHT; y++) {
            memset(rowBitData, 0, sizeof(rowBitData));

            int x = startX;
            for (int chIndex = 0; chIndex < lineChars; chIndex++) {
                // simply copy and place images, 1bpp format
                uint8_t raster = CHAR_RASTERS[rasterIndexes[chIndex]][y];
                for (int i = 0; i < 8; i++) {
                    if ((raster & (1 << (7 - i))) == 0) {
                        x += format.scale;
                        continue;
                    }

                    // scale in X direction
                    for (int j = 0; j < format.scale; j++) {
                        uint8_t& b = rowBitData[x / 8];
                        b |= (1 << (7 - x % 8));
                        x++;
                    }
                }
            }

            // print multiply times to scale in Y direction
            uint8_t rowCopy[sizeof(rowBitData)];
            for (int i = 0; i < format.scale; i++) {
                memcpy(rowCopy, rowBitData, sizeof(rowBitData));
                printLine1b(rowCopy);
            }
        }
    }

private:
    // send 1bpp data to printhead and begin heating
    void beginPrintLine(uint8_t* data) {
        if (!isPaperReady()) {
            return;
        }

        STROBE_L;
        LATCH_L;
        SPI.transfer(data, ROW_WIDTH / 8);
        LATCH_H;
        STROBE_H;
    }

    // stop heating
    void endPrintLine() {
        STROBE_L;
    }

private:
    StepMotor motor;
};


// ============================
// Typewriter

constexpr int SCALED_CHAR_WIDTH  = CHAR_WIDTH * TEXT_SCALE;
constexpr int SCALED_CHAR_HEIGHT = CHAR_HEIGHT * TEXT_SCALE;
constexpr int ROW_CHARS = ROW_WIDTH / SCALED_CHAR_WIDTH;

ThermalPrinter printer;
TextFormat format;
char textBuf[ROW_CHARS + 1];    // input text buffer
int lastPos = 0;                // last printed position

void setup()
{
    // connect to PC USB serial
    Serial.begin(115200);

    printer.powerOn();
    printer.feedLine(50);

    format.scale = TEXT_SCALE;
}

void loop()
{
    bool newLine = false;  // need break line
    int newPos = lastPos;
    while (newPos < ROW_CHARS) {
        int c = Serial.read();
        if (c < 0) {
            break;
        }

        // force break line on receiving Enter
        if (c == '\n') {
            newLine = true;
            break;
        }

        // buffer valid characters
        if (c >= CHAR_BEGIN && c <= CHAR_BEGIN + ARRAY_SIZE(CHAR_RASTERS)) {
            textBuf[newPos++] = c;
        }
    }

    // idle when possible to save power
    if (newPos == lastPos && !newLine) {
        printer.idle();
        return;
    }

    // has new characters to print
    if (newPos != lastPos) {
        // roll back current line to heating points
        printer.feedLine(-FEED_MARGIN - SCALED_CHAR_HEIGHT);
        textBuf[newPos] = '\0';
        printer.printText(textBuf, format);

        if (newPos < ROW_CHARS) {
            // clear printed characters
            memset(textBuf + lastPos, ' ', newPos - lastPos);
            lastPos = newPos;
        } else {
            // line full, move to new line
            lastPos = 0;
            printer.feedLine(SCALED_CHAR_HEIGHT);
        }

        //FIXME: 1-off bug, don't know why but this works
        printer.feedLine(FEED_MARGIN - 1);
    }
    
    if (newLine) {
        lastPos = 0;
        printer.feedLine(SCALED_CHAR_HEIGHT);
    }
}
